## src/IMU_i2c/build/Kconfig/Kconfig.shield
```kconfig
osource "d:/memfault_ble_demo/boards/shields/*/Kconfig.shield"
osource "C:/ncs/v2.6.1/nrf/boards/shields/*/Kconfig.shield"
```

## src/IMU_i2c/build/Kconfig/Kconfig.shield.defconfig
```kconfig
osource "d:/memfault_ble_demo/boards/shields/*/Kconfig.defconfig"
osource "C:/ncs/v2.6.1/nrf/boards/shields/*/Kconfig.defconfig"
```

## src/batteryless-gadgets/build/Kconfig/arch/Kconfig
```kconfig
# Load arch Kconfig descriptions.
osource "/Users/mark/zephyr/arch/x86/Kconfig"
osource "/Users/mark/zephyr/arch/xtensa/Kconfig"
osource "/Users/mark/zephyr/arch/sparc/Kconfig"
osource "/Users/mark/zephyr/arch/riscv/Kconfig"
osource "/Users/mark/zephyr/arch/posix/Kconfig"
osource "/Users/mark/zephyr/arch/nios2/Kconfig"
osource "/Users/mark/zephyr/arch/mips/Kconfig"
osource "/Users/mark/zephyr/arch/arm64/Kconfig"
osource "/Users/mark/zephyr/arch/arm/Kconfig"
osource "/Users/mark/zephyr/arch/arc/Kconfig"
```

## src/batteryless-gadgets/build_52833/Kconfig/Kconfig.shield
```kconfig
osource "/Users/mark/memfault_ble_demo/boards/shields/*/Kconfig.shield"
osource "/Users/mark/nrf/boards/shields/*/Kconfig.shield"
```

## src/batteryless-gadgets/build_52833/Kconfig/Kconfig.shield.defconfig
```kconfig
osource "/Users/mark/memfault_ble_demo/boards/shields/*/Kconfig.defconfig"
osource "/Users/mark/nrf/boards/shields/*/Kconfig.defconfig"
```

## src/batteryless-gadgets/build_52833/Kconfig/soc/Kconfig
```kconfig
# Load Zephyr SoC Kconfig descriptions.
osource "/Users/mark/zephyr/soc/xlnx/zynqmp/Kconfig"
osource "/Users/mark/zephyr/soc/xlnx/zynq7000/Kconfig"
osource "/Users/mark/zephyr/soc/xen/Kconfig"
osource "/Users/mark/zephyr/soc/ti/simplelink/Kconfig"
osource "/Users/mark/zephyr/soc/ti/lm3s6965/Kconfig"
osource "/Users/mark/zephyr/soc/ti/k3/Kconfig"
osource "/Users/mark/zephyr/soc/telink/tlsr/Kconfig"
osource "/Users/mark/zephyr/soc/starfive/jh71xx/Kconfig"
osource "/Users/mark/zephyr/soc/st/stm32/Kconfig"
osource "/Users/mark/zephyr/soc/snps/qemu_arc/Kconfig"
osource "/Users/mark/zephyr/soc/snps/nsim/Kconfig"
osource "/Users/mark/zephyr/soc/snps/hsdk4xd/Kconfig"
osource "/Users/mark/zephyr/soc/snps/hsdk/Kconfig"
osource "/Users/mark/zephyr/soc/snps/emsk/Kconfig"
osource "/Users/mark/zephyr/soc/snps/emsdp/Kconfig"
osource "/Users/mark/zephyr/soc/snps/arc_iot/Kconfig"
osource "/Users/mark/zephyr/soc/silabs/Kconfig"
osource "/Users/mark/zephyr/soc/sifive/sifive_freedom/Kconfig"
osource "/Users/mark/zephyr/soc/rockchip/Kconfig"
osource "/Users/mark/zephyr/soc/renode/riscv_virtual/Kconfig"
osource "/Users/mark/zephyr/soc/renesas/smartbond/Kconfig"
osource "/Users/mark/zephyr/soc/renesas/rzt2m/Kconfig"
osource "/Users/mark/zephyr/soc/renesas/rcar/Kconfig"
osource "/Users/mark/zephyr/soc/renesas/ra/Kconfig"
osource "/Users/mark/zephyr/soc/raspberrypi/Kconfig"
osource "/Users/mark/zephyr/soc/quicklogic/eos_s3/Kconfig"
osource "/Users/mark/zephyr/soc/qemu/virt_riscv/Kconfig"
osource "/Users/mark/zephyr/soc/qemu/malta/Kconfig"
osource "/Users/mark/zephyr/soc/openisa/rv32m1/Kconfig"
osource "/Users/mark/zephyr/soc/nxp/s32/Kconfig"
osource "/Users/mark/zephyr/soc/nxp/rw/Kconfig"
osource "/Users/mark/zephyr/soc/nxp/mcx/Kconfig"
osource "/Users/mark/zephyr/soc/nxp/lpc/Kconfig"
osource "/Users/mark/zephyr/soc/nxp/layerscape/Kconfig"
osource "/Users/mark/zephyr/soc/nxp/kinetis/Kconfig"
osource "/Users/mark/zephyr/soc/nxp/imxrt/Kconfig"
osource "/Users/mark/zephyr/soc/nxp/imx/Kconfig"
osource "/Users/mark/zephyr/soc/nuvoton/numicro/Kconfig"
osource "/Users/mark/zephyr/soc/nuvoton/numaker/Kconfig"
osource "/Users/mark/zephyr/soc/nuvoton/npcx/Kconfig"
osource "/Users/mark/zephyr/soc/nordic/Kconfig"
osource "/Users/mark/zephyr/soc/neorv32/Kconfig"
osource "/Users/mark/zephyr/soc/native/inf_clock/Kconfig"
osource "/Users/mark/zephyr/soc/microchip/miv/Kconfig"
osource "/Users/mark/zephyr/soc/microchip/mec/Kconfig"
osource "/Users/mark/zephyr/soc/lowrisc/opentitan/Kconfig"
osource "/Users/mark/zephyr/soc/litex/litex_vexriscv/Kconfig"
osource "/Users/mark/zephyr/soc/ite/ec/Kconfig"
osource "/Users/mark/zephyr/soc/intel/raptor_lake/Kconfig"
osource "/Users/mark/zephyr/soc/intel/lakemont/Kconfig"
osource "/Users/mark/zephyr/soc/intel/intel_socfpga_std/Kconfig"
osource "/Users/mark/zephyr/soc/intel/intel_socfpga/Kconfig"
osource "/Users/mark/zephyr/soc/intel/intel_niosv/Kconfig"
osource "/Users/mark/zephyr/soc/intel/intel_ish/Kconfig"
osource "/Users/mark/zephyr/soc/intel/intel_adsp/Kconfig"
osource "/Users/mark/zephyr/soc/intel/elkhart_lake/Kconfig"
osource "/Users/mark/zephyr/soc/intel/atom/Kconfig"
osource "/Users/mark/zephyr/soc/intel/apollo_lake/Kconfig"
osource "/Users/mark/zephyr/soc/intel/alder_lake/Kconfig"
osource "/Users/mark/zephyr/soc/infineon/cat3/Kconfig"
osource "/Users/mark/zephyr/soc/infineon/cat1a/Kconfig"
osource "/Users/mark/zephyr/soc/gd/gd32/Kconfig"
osource "/Users/mark/zephyr/soc/gaisler/leon3/Kconfig"
osource "/Users/mark/zephyr/soc/gaisler/gr716a/Kconfig"
osource "/Users/mark/zephyr/soc/espressif/Kconfig"
osource "/Users/mark/zephyr/soc/ene/kb1200/Kconfig"
osource "/Users/mark/zephyr/soc/efinix/sapphire/Kconfig"
osource "/Users/mark/zephyr/soc/cdns/xtensa_sample_controller/Kconfig"
osource "/Users/mark/zephyr/soc/cdns/dc233c/Kconfig"
osource "/Users/mark/zephyr/soc/brcm/bcmvk/Kconfig"
osource "/Users/mark/zephyr/soc/brcm/bcm2712/Kconfig"
osource "/Users/mark/zephyr/soc/brcm/bcm2711/Kconfig"
osource "/Users/mark/zephyr/soc/atmel/sam0/Kconfig"
osource "/Users/mark/zephyr/soc/atmel/sam/Kconfig"
osource "/Users/mark/zephyr/soc/aspeed/Kconfig"
osource "/Users/mark/zephyr/soc/arm/Kconfig"
osource "/Users/mark/zephyr/soc/arm/beetle/Kconfig"
osource "/Users/mark/zephyr/soc/andestech/Kconfig"
osource "/Users/mark/zephyr/soc/ambiq/Kconfig"
osource "/Users/mark/zephyr/soc/altr/zephyr_nios2f/Kconfig"
osource "/Users/mark/zephyr/soc/altr/qemu_nios2/Kconfig"
```
